/*
 * Copyright (c) 2025 STMicroelectronics
 *
 * SPDX-License-Identifier: Apache-2.0
 */

usart_mux: &usart1 {
	dmas = <&gpdma1 0 12 STM32_DMA_PERIPH_TX>,
	       <&gpdma1 1 11 (STM32_DMA_PERIPH_RX | STM32_DMA_MODE_CYCLIC)>;
	dma-names = "tx", "rx";
	fifo-enable;
	status = "okay";
	current-speed = <115200>;
	hw-flow-control;
};

&gpdma1 {
	status = "okay";
};

