## soc/arm/st_bluenrg/bluenrg/Kconfig.series
```kconfig
# Copyright (c) 2019 Lexmark International, Inc.
# Copyright (c) 2019 Stephanos Ioannidis <root@stephanos.io>
# SPDX-License-Identifier: Apache-2.0

config SOC_SERIES_BLUENRG
	bool "BLUENRG Series MCU"
	select ARM
	select CPU_CORTEX_M0PLUS
	select SOC_FAMILY_BLUENRG
	select CPU_CORTEX_M_HAS_SYSTICK
	select CORTEX_M_SYSTICK
    help
	  Enable support for BLUENRG MCU series
```

## soc/arm/st_bluenrg/bluenrg/Kconfig.soc
```kconfig
# ST Microelectronics BLUENRG MCU line

# Copyright (c) 2019 Linaro Limited
# SPDX-License-Identifier: Apache-2.0

choice
	prompt "BLUENRG_LP MCU Selection"
	depends on SOC_SERIES_BLUENRG

config SOC_BLUENRG_LP
	bool "BLUENRG_LP"

endchoice
```

## soc/arm/st_bluenrg/bluenrg_3/Kconfig.defconfig.series
```kconfig
# ST Microelectronics BlueNRG MCU line

# Copyright (c) 2019 Linaro Limited
# SPDX-License-Identifier: Apache-2.0

if SOC_SERIES_BLUENRG_3

config SOC_SERIES
	default "bluenrg_3"
	
source "soc/arm/st_bluenrg/bluenrg_3/Kconfig.defconfig.bluenrg_lp*"

endif # SOC_SERIES_BLUENRG_3
```

## soc/st/st_bluenrg/Kconfig
```kconfig
# ST Microelectronics STM32 MCU line

# Copyright (c) 2016 Open-RnD Sp. z o.o.
# SPDX-License-Identifier: Apache-2.0

config SOC_FAMILY_BLUENRG
	bool
	select BUILD_OUTPUT_HEX

if SOC_FAMILY_BLUENRG
config SOC_FAMILY
	string
	default "st_bluenrg"

source "soc/st/st_bluenrg/*/Kconfig.soc"

endif # SOC_FAMILY_BLUENRG
```

## soc/st/st_bluenrg/bluenrg_3/Kconfig.defconfig.bluenrg_lp
```kconfig
# ST Microelectronics BlueNRG-LP MCU

# Copyright (c) 2019 Linaro Limited
# SPDX-License-Identifier: Apache-2.0

config SOC
	default "bluenrg_lp"
	depends on SOC_BLUENRG_LP

config NUM_IRQS
	default 32
```

## soc/st/st_bluenrg/bluenrg_3/Kconfig.defconfig.bluenrg_lpf
```kconfig
# STMicroelectronics BlueNRG-LPF MCU

# Copyright (c) 2024 STMicroelectronics
# SPDX-License-Identifier: Apache-2.0

config SOC
	default "bluenrg_lpf"
	depends on SOC_BLUENRG_LPF

config NUM_IRQS
	default 32
```

## soc/st/st_bluenrg/bluenrg_3/Kconfig.defconfig.bluenrg_lps
```kconfig
# STMicroelectronics BlueNRG-LPS MCU

# Copyright (c) 2024 STMicroelectronics
# SPDX-License-Identifier: Apache-2.0

config SOC
	default "bluenrg_lps"
	depends on SOC_BLUENRG_LPS

config NUM_IRQS
	default 32
```

## soc/st/st_bluenrg/bluenrg_3/Kconfig.soc
```kconfig
# STMicroelectronics BLUENRG MCU line

# Copyright (c) 2019 Linaro Limited
# SPDX-License-Identifier: Apache-2.0

choice
	prompt "BLUENRG_LPx MCU Selection"
	depends on SOC_SERIES_BLUENRG_3

config SOC_BLUENRG_LP
	bool "BLUENRG-LP (BlueNRG-355)"

config SOC_BLUENRG_LPS
	bool "BLUENRG-LPS (BlueNRG-332)"

endchoice
```
