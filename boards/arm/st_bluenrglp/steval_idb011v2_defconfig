## boards/arm/st_bluenrglp/steval_idb011v2_defconfig
```kconfig
# SPDX-License-Identifier: Apache-2.0

# Zephyr Kernel Configuration
CONFIG_SOC_SERIES_BLUENRG_3=y

# Platform Configuration
CONFIG_SOC_BLUENRG_LP=y

CONFIG_SYS_CLOCK_HW_CYCLES_PER_SEC=120000000

# # Enable MPU
# CONFIG_ARM_MPU=y

# Serial Drivers
CONFIG_SERIAL=y
CONFIG_UART_INTERRUPT_DRIVEN=n
# enable console
CONFIG_CONSOLE=y
CONFIG_UART_CONSOLE=y

# GPIO Controller
CONFIG_GPIO=n

# Enable Clocks
CONFIG_CLOCK_CONTROL=n

# enable pin controller
CONFIG_PINCTRL=n
```

## boards/st/st_bluenrglp/Kconfig.defconfig
```kconfig
# STM32F412G-DISCO board configuration

# SPDX-License-Identifier: Apache-2.0

if BOARD_STEVAL_IDB011V2

config BOARD
	default "steval_idb011v2"

endif # BOARD_STEVAL_IDB011V2
```

## boards/st/st_bluenrglp/steval_idb011v2_defconfig
```kconfig
# SPDX-License-Identifier: Apache-2.0

# Zephyr Kernel Configuration
CONFIG_SOC_SERIES_BLUENRG_3=y

# Platform Configuration
CONFIG_DEVICE_BLUENRG_LP=y

CONFIG_SYS_CLOCK_HW_CYCLES_PER_SEC=64000000

# # Enable MPU
# CONFIG_ARM_MPU=y

# Serial Drivers
CONFIG_SERIAL=y
CONFIG_UART_INTERRUPT_DRIVEN=n
# enable console
CONFIG_CONSOLE=y
CONFIG_UART_CONSOLE=y

# GPIO Controller
CONFIG_GPIO=y

# Enable Clocks
CONFIG_CLOCK_CONTROL=y
CONFIG_CLOCK_CONTROL_BLUENRG_3=y

# enable pin controller
CONFIG_PINCTRL=y
```

## boards/st/steval_idb011v2/Kconfig.defconfig
```kconfig
# STM32F412G-DISCO board configuration

# SPDX-License-Identifier: Apache-2.0

if BOARD_STEVAL_IDB011V2

config BOARD
	default "steval_idb011v2"

if BT

choice BT_HCI_BUS_TYPE
	default BT_STM32WB0
endchoice

choice BT_RECV_CONTEXT
	default BT_RECV_WORKQ_BT
endchoice

config BT_HCI_ACL_FLOW_CONTROL
	default n

endif # BT

endif # BOARD_STEVAL_IDB011V2
```

## boards/st/steval_idb011v2/Kconfig.steval_idb011v2
```kconfig
# BLUENRG-355 board configuration

# SPDX-License-Identifier: Apache-2.0

config BOARD_STEVAL_IDB011V2
	bool "BLUENRG-LP Development Board"
	depends on SOC_BLUENRG_LP
```

## boards/st/steval_idb012v1/Kconfig.defconfig
```kconfig
# STEVAL-IDB012V1 board configuration

# Copyright (c) 2024 STMicroelectronics
# SPDX-License-Identifier: Apache-2.0

if BOARD_STEVAL_IDB012V1

config BOARD
	default "steval_idb012v1"

if BT

choice BT_HCI_BUS_TYPE
	default BT_STM32WB0
endchoice

choice BT_RECV_CONTEXT
	default BT_RECV_WORKQ_BT
endchoice

config BT_HCI_ACL_FLOW_CONTROL
	default n

endif # BT

endif # BOARD_STEVAL_IDB012V1
```

## boards/st/steval_idb012v1/Kconfig.steval_idb012v1
```kconfig
# Copyright (c) 2024 STMicroelectronics
# SPDX-License-Identifier: Apache-2.0

config BOARD_STEVAL_IDB012V1
	bool "BLUENRG-LPS Evaluation Board"
	depends on SOC_BLUENRG_LPS
```

## boards/st/steval_idb012v2/Kconfig.defconfig
```kconfig
# STEVAL-IDB012V2 board configuration

# Copyright (c) 2024 STMicroelectronics
# SPDX-License-Identifier: Apache-2.0

if BOARD_STEVAL_IDB012V2

config BOARD
	default "steval_idb012v2"

if BT

choice BT_HCI_BUS_TYPE
	default BT_STM32WB0
endchoice

choice BT_RECV_CONTEXT
	default BT_RECV_WORKQ_BT
endchoice

config BT_HCI_ACL_FLOW_CONTROL
	default n

endif # BT

endif # BOARD_STEVAL_IDB012V2
```

## boards/st/steval_idb012v2/Kconfig.steval_idb012v2
```kconfig
# Copyright (c) 2024 STMicroelectronics
# SPDX-License-Identifier: Apache-2.0

config BOARD_STEVAL_IDB012V2
	bool "BLUENRG-LPF Evaluation Board"
	depends on SOC_BLUENRG_LPF
```

## drivers/clock_control/Kconfig.bluenrg
```kconfig
# BlueNRG MCU clock control driver config

# Copyright (c) 2017 Linaro
# Copyright (c) 2017 RnDity Sp. z o.o.
# SPDX-License-Identifier: Apache-2.0

menuconfig CLOCK_CONTROL_BLUENRG_3
	bool "BlueNRG Reset & Clock Control"
	depends on SOC_SERIES_BLUENRG_3
	#select CLOCK_CONTROL_BLUENRG_3
	help
	  Enable driver for Reset & Clock Control subsystem found
	  in BlueNRG-LPx series of MCUs

DT_STM32_HSE_CLOCK := $(dt_nodelabel_path,clk_hse)
DT_STM32_HSE_CLOCK_FREQ := $(dt_node_int_prop_int,$(DT_STM32_HSE_CLOCK),clock-frequency)

config CLOCK_BLUENRG_HSE_CLOCK
	int "HSE clock value"
	default "$(DT_STM32_HSE_CLOCK_FREQ)" if "$(dt_nodelabel_enabled,clk_hse)"
	default 32000000
	help
	  Value of external high-speed clock (HSE). This symbol could be optionally
	  configured using device tree by setting "clock-frequency" value of clk_hse
	  node. For instance:
	  &clk_hse{
	  status = "okay";
	  clock-frequency = <DT_FREQ_M(25)>;
	  };
	  Note: Device tree configuration is overridden when current symbol is set:
	  CONFIG_CLOCK_BLUENRG_HSE_CLOCK=32000000
```

## drivers/flash/Kconfig.bluenrg
```kconfig
# ST Microelectronics STM32 MCUs Flash driver config

# Copyright (c) 2016 RnDity Sp. z o.o.
# Copyright (c) 2017 BayLibre, SAS
# Copyright (c) 2022 Linaro Limited
# Copyright (c) 2023 Google Inc
# SPDX-License-Identifier: Apache-2.0

config SOC_FLASH_BLUENRG
	bool "BLUENRG flash driver"
	depends on (DT_HAS_ST_STM32_FLASH_CONTROLLER_ENABLED || \
		   DT_HAS_ST_STM32H7_FLASH_CONTROLLER_ENABLED) && SOC_SERIES_BLUENRG_3
	select FLASH_HAS_DRIVER_ENABLED
	default y
	select FLASH_PAGE_LAYOUT
	select FLASH_HAS_PAGE_LAYOUT
	select FLASH_HAS_EX_OP
	select MPU_ALLOW_FLASH_WRITE if ARM_MPU
	help
	  Enable flash driver for BLUENRG-3 series

if SOC_FLASH_BLUENRG

config FLASH_STM32_WRITE_PROTECT
	bool "Extended operation for flash write protection control"
	default n
	help
	  Enables flash extended operation for enabling/disabling flash write
	  protection.

config FLASH_STM32_READOUT_PROTECTION
	bool "Extended operation for flash readout protection control"
	default n
	help
	  Enables flash extended operation for enabling/disabling flash readout
	  protection.

endif # SOC_FLASH_BLUENRG
```

## drivers/gpio/Kconfig.bluenrg
```kconfig
# STM32 GPIO configuration

# Copyright (c) 2016 Open-RnD Sp. z o.o.
# SPDX-License-Identifier: Apache-2.0

config GPIO_BLUENRG
	bool "GPIO Driver for BlueNRG-LPx Series of MCUs"
	default y
	depends on DT_HAS_ST_STM32_GPIO_ENABLED && SOC_SERIES_BLUENRG_3
	help
	  Enable GPIO driver for BlueNRG-LPx line of MCUs
```

## drivers/interrupt_controller/Kconfig.bluenrg
```kconfig
# STM32 EXTI configuration

# Copyright (c) 2016 Open-RnD Sp. z o.o.
# SPDX-License-Identifier: Apache-2.0

if SOC_FAMILY_BLUENRG

config EXTI_BLUENRG
	bool "External Interrupt/Event Controller (EXTI) Driver for BlueNRG family of MCUs"
	default y
	depends on DT_HAS_ST_STM32_EXTI_ENABLED
	help
	  Enable EXTI driver for BlueNRG line of MCUs

endif # SOC_FAMILY_BLUENRG
```

## drivers/pinctrl/Kconfig.bluenrg
```kconfig
# Copyright (c) 2023 STMicroelectronics
# SPDX-License-Identifier: Apache-2.0

config PINCTRL_BLUENRG_3
	bool "BlueNRG-LPx pin controller driver"
	default y
	depends on DT_HAS_ST_STM32_PINCTRL_ENABLED && SOC_SERIES_BLUENRG_3
	help
	  BlueNRG-LPx pinctrl driver
```

## drivers/serial/Kconfig.bluenrg
```kconfig
# BLUENRG UART configuration

# Copyright (c) 2016 Open-RnD Sp. z o.o.
# SPDX-License-Identifier: Apache-2.0

config UART_BLUENRG
	bool "BLUENRG MCU serial driver"
	default y
	depends on DT_HAS_ST_STM32_UART_ENABLED && SOC_SERIES_BLUENRG_3
	select SERIAL_HAS_DRIVER
	select SERIAL_SUPPORT_INTERRUPT
	select RESET
	help
	  This option enables the UART driver for BLUENRG family of
	  processors.
	  Say y if you wish to use serial port on BLUENRG MCU.
```

## rcp_ble_ot/app_rcp/boards/st/custom_wba55cg/Kconfig.custom_wba55cg
```kconfig
# Copyright (c) 2023 STMicroelectronics
# SPDX-License-Identifier: Apache-2.0

config BOARD_CUSTOM_WBA55CG
	select SOC_STM32WBA55XX
```

## rcp_ble_ot/app_rcp/boards/st/custom_wba55cg/board.yml
```yaml
board:
  name: custom_wba55cg
  full_name: Custom WBA55CG
  vendor: st
  socs:
    - name: stm32wba55xx
```

## rcp_ble_ot/src/Kconfig.uart_mux
```kconfig
menuconfig UART_MUX
	bool "UART multiplexer"
	default y
	help
	  Enable application-level UART multiplexer.

if UART_MUX

config UART_MUX_PHY_RX_BUF_SIZE
	int "Physical UART RX buffer size"
	range 32 256
	default 64

config UART_MUX_RX_BUF_SIZE
	int "Virtual UART RX payload buffer size"
	range 64 4096
	default 256

config UART_MUX_RX_TIMEOUT_MS
	int "RX resync timeout (ms)"
	default 50

endif # UART_MUX
```

## rcp_ble_ot/tests/uart_mux/testcase.yaml
```yaml
tests:
  uart_mux.basic:
    tags:
      - uart
      - mux
      - async
    platform_allow:
      - native_sim
    harness: ztest
    harness_config:
      type: unit
    integration_platforms:
      - native_sim
```

## soc/arm/st_bluenrg/Kconfig.defconfig
```kconfig
# SPDX-License-Identifier: Apache-2.0

if SOC_FAMILY_BLUENRG
source "soc/arm/st_bluenrg/*/Kconfig.defconfig.series"

# ???
#config PINCTRL
#    default y

endif
```

## soc/arm/st_bluenrg/bluenrg/Kconfig.defconfig.bluenrg_lp
```kconfig
# ST Microelectronics STM32WB55XX MCU

# Copyright (c) 2019 Linaro Limited
# SPDX-License-Identifier: Apache-2.0

if SOC_BLUENRG_LP

config SOC
	default "bluenrg_lp"

config NUM_IRQS
	default 32

endif # SOC_BLUENRG_LP
```

## soc/arm/st_bluenrg/bluenrg/Kconfig.defconfig.series
```kconfig
# ST Microelectronics STM32WB MCU line

# Copyright (c) 2019 Linaro Limited
# SPDX-License-Identifier: Apache-2.0

if SOC_SERIES_BLUENRG

config SOC_SERIES
	default "bluenrg"

source "soc/arm/st_bluenrg/bluenrg/Kconfig.defconfig.bluenrg_lp*"

endif # SOC_SERIES_BLUENRG
```
